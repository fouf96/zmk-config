## boards/shields/corne/Kconfig.defconfig
```kconfig
# This file sets the the board specific configuration
# see https://docs.zephyrproject.org/latest/build/kconfig/setting.html#initial-conf

if SHIELD_ARDEA_CORNE_LEFT

config ZMK_KEYBOARD_NAME
    default "ardea_corne"

config ZMK_SPLIT_ROLE_CENTRAL
    default y

endif # SHIELD_ardea_corne_LEFT

if SHIELD_ARDEA_CORNE_LEFT || SHIELD_ARDEA_CORNE_RIGHT

config ZMK_SPLIT
    default y

config ARDEA_CORNE_RGB_UNDERGLOW
    bool "ardea_corne per Key RGB LEDs"
    default n
    select ZMK_RGB_UNDERGLOW
    select WS2812_STRIP
    select SPI
    select ZMK_RGB_UNDERGLOW_AUTO_OFF_IDLE
    select ZMK_RGB_UNDERGLOW_AUTO_OFF_USB

config ARDEA_CORNE_DISPLAY
    bool "ardea_corne OLED Display"
    default y
    select ZMK_DISPLAY
    select I2C
    select SSD1306


if LVGL

config LV_Z_VDB_SIZE
    default 64

config LV_DPI_DEF
    default 148

config LV_Z_BITS_PER_PIXEL
    default 1

choice LV_COLOR_DEPTH
    default LV_COLOR_DEPTH_1
endchoice

endif # LVGL

    
endif # SHIELD_ARDEA_CORNE_LEFT || SHIELD_ARDEA_CORNE_RIGHT
```

## boards/shields/corne/Kconfig.shield
```kconfig
# Define shield specific symbols (configuration options/ what i would
# call "configuration variables")

config SHIELD_ARDEA_CORNE_LEFT
    def_bool $(shields_list_contains,ardea_corne_left)

config SHIELD_ARDEA_CORNE_RIGHT
    def_bool $(shields_list_contains,ardea_corne_right)

# ---
# Note to self:
# def_bool X > 2
# is the same as 
# bool
# default X > 2
# see https://docs.zephyrproject.org/latest/build/kconfig/tips.html
```

## boards/shields/kamo_corne_mx/Kconfig.defconfig
```kconfig
# This file sets the the board specific configuration
# see https://docs.zephyrproject.org/latest/build/kconfig/setting.html#initial-conf

if SHIELD_KAMO_CORNE_MX_LEFT

config ZMK_KEYBOARD_NAME
    default "kamo_corne_mx"

config ZMK_SPLIT_ROLE_CENTRAL
    default y

endif # SHIELD_kamo_corne_mx_LEFT

if SHIELD_KAMO_CORNE_MX_LEFT || SHIELD_KAMO_CORNE_MX_RIGHT

config ZMK_SPLIT
    default y

config ZMK_DISPLAY
    bool "OLED Display"
    default y
    select I2C
    select SSD1306


if LVGL

config LV_Z_VDB_SIZE
    default 64

config LV_DPI_DEF
    default 148

config LV_Z_BITS_PER_PIXEL
    default 1

choice LV_COLOR_DEPTH
    default LV_COLOR_DEPTH_1
endchoice

endif # LVGL

config ZMK_RGB_UNDERGLOW
    bool "Per Key & Underglow RGB LEDs"
    default n
    select WS2812_STRIP
    select SPI
    select ZMK_RGB_UNDERGLOW_AUTO_OFF_IDLE
    select ZMK_RGB_UNDERGLOW_AUTO_OFF_USB


endif # SHIELD_KAMO_CORNE_MX_LEFT || SHIELD_KAMO_CORNE_MX_RIGHT
```

## boards/shields/kamo_corne_mx/Kconfig.shield
```kconfig
# Define shield specific symbols (configuration options/ what i would
# call "configuration variables")

config SHIELD_KAMO_CORNE_MX_LEFT
    def_bool $(shields_list_contains,kamo_corne_mx_left)

config SHIELD_KAMO_CORNE_MX_RIGHT
    def_bool $(shields_list_contains,kamo_corne_mx_right)

# ---
# Note to self:
# def_bool X > 2
# is the same as 
# bool
# default X > 2
# see https://docs.zephyrproject.org/latest/build/kconfig/tips.html
```

## boards/shields/tukon/Kconfig.defconfig
```kconfig
# This file sets the the board specific configuration
# see https://docs.zephyrproject.org/latest/build/kconfig/setting.html#initial-conf

if SHIELD_TUKON_LEFT

config ZMK_KEYBOARD_NAME
    default "Tukon"

config ZMK_SPLIT_ROLE_CENTRAL
    default y

endif # SHIELD_TUKON_LEFT

if SHIELD_TUKON_LEFT || SHIELD_TUKON_RIGHT

config ZMK_SPLIT
    default y

if ZMK_RGB_UNDERGLOW

config WS2812_STRIP
    default y

config SPI
    default y

config ZMK_RGB_UNDERGLOW_EFF_START
    default 0

endif # ZMK_RGB_UNDERGLOW


config TUKON_DISPLAY
    bool "Tukon OLED Display"
    default y
    select ZMK_DISPLAY
    select I2C
    select SSD1306


if LVGL

config LV_Z_VDB_SIZE
    default 64

config LV_DPI_DEF
    default 148

config LV_Z_BITS_PER_PIXEL
    default 1

choice LV_COLOR_DEPTH
    default LV_COLOR_DEPTH_1
endchoice

endif # LVGL

    
endif # SHIELD_TUKON_LEFT || SHIELD_TUKON_RIGHT
```
